## scupatch/scu_defconfig
```kconfig
CONFIG_AGP=y
CONFIG_ATA_PIIX=y
CONFIG_ATA=y
CONFIG_B53_MDIO_DRIVER=y
CONFIG_B53_MMAP_DRIVER=y
CONFIG_B53_SPI_DRIVER=y
CONFIG_B53_SRAB_DRIVER=y
CONFIG_B53=y
CONFIG_BLK_CGROUP=y
CONFIG_BLK_DEV_INITRD=y
CONFIG_BLK_DEV_INTEGRITY=y
CONFIG_BLK_DEV_LOOP=y
CONFIG_BLK_DEV_RAM_COUNT=4
CONFIG_BLK_DEV_RAM_SIZE=200000
CONFIG_BLK_DEV_RAM=y
CONFIG_BLK_DEV_SD=y
CONFIG_BRIDGE_EBT_IP=y
CONFIG_BRIDGE_EBT_PKTTYPE=y
CONFIG_BRIDGE_EBT_T_FILTER=y
CONFIG_BRIDGE_NETFILTER=y
CONFIG_BRIDGE_NF_EBTABLES=y
CONFIG_BRIDGE_VLAN_FILTERING=y
CONFIG_BRIDGE=y
CONFIG_CFS_BANDWIDTH=y
CONFIG_CGROUP_CPUACCT=y
CONFIG_CGROUP_DEVICE=y
CONFIG_CGROUP_FREEZER=y
CONFIG_CGROUP_PERF=y
CONFIG_CHR_DEV_SG=y
CONFIG_CLS_U32_MARK=y
CONFIG_CLS_U32_PERF=y
CONFIG_CONFIGFS_FS=y
CONFIG_CPU_FREQ_DEFAULT_GOV_ONDEMAND=y
CONFIG_CPUSETS=y
CONFIG_CRYPTO_AES_NI_INTEL=y
CONFIG_CRYPTO_ANSI_CPRNG=y
CONFIG_CRYPTO_CRC32_PCLMUL=y
CONFIG_CRYPTO_CRC32=y
CONFIG_CRYPTO_CRC32C_INTEL=y
CONFIG_CRYPTO_MD5=y
CONFIG_CRYPTO_SHA1=y
CONFIG_CRYPTO_USER_API_HASH=y
CONFIG_DEBUG_DRIVER=y
CONFIG_DEBUG_GPIO=y
CONFIG_DEFAULT_MMAP_MIN_ADDR=32768
CONFIG_DEVTMPFS_MOUNT=y
CONFIG_DEVTMPFS=y
CONFIG_DMI_SYSFS=y
CONFIG_DRM_I915=y
CONFIG_DRM_LOAD_EDID_FIRMWARE=y
CONFIG_DRM=y
CONFIG_DS1682=y
CONFIG_DYNAMIC_DEBUG=y
CONFIG_E1000E=y
CONFIG_EARLY_PRINTK_EFI=y
CONFIG_EDAC=y
CONFIG_EEPROM_AT24=y
CONFIG_EFI_STUB=y
CONFIG_EFI_VARS=y
CONFIG_EFI=y
CONFIG_EMBEDDED=y
CONFIG_EXT2_FS_POSIX_ACL=y
CONFIG_EXT2_FS_SECURITY=y
CONFIG_EXT2_FS_XATTR=y
CONFIG_EXT2_FS=y
CONFIG_EXT3_FS_POSIX_ACL=y
CONFIG_EXT3_FS_SECURITY=y
CONFIG_EXT3_FS=y
CONFIG_EXT4_DEBUG=y
CONFIG_FANOTIFY=y
CONFIG_FB_VESA=y
CONFIG_FB_VGA16=y
CONFIG_FRAMEBUFFER_CONSOLE=y
CONFIG_FUNCTION_TRACER=y
CONFIG_FUSE_FS=y
CONFIG_FW_LOADER_USER_HELPER_FALLBACK=y
CONFIG_GPIO_ICH=y
CONFIG_GPIO_PCA953X_IRQ=y
CONFIG_GPIO_PCA953X=y
CONFIG_GPIO_SYSFS=y
CONFIG_GPIOLIB=y
CONFIG_HIGH_RES_TIMERS=y
CONFIG_HPET=y
CONFIG_HW_RANDOM=y
CONFIG_HWMON_DEBUG_CHIP=y
CONFIG_HZ_1000=y
CONFIG_I2C_CHARDEV=y
CONFIG_I2C_GPIO=y
CONFIG_I2C_I801=y
CONFIG_I2C_KEMPLD=y
CONFIG_I2C_MUX=y
CONFIG_IGB=y
CONFIG_IKCONFIG_PROC=y
CONFIG_IKCONFIG=y
CONFIG_INET=y
CONFIG_INPUT_EVDEV=y
CONFIG_IP_MULTICAST=y
CONFIG_IP_NF_IPTABLES=y
CONFIG_IP_PNP_DHCP=y
CONFIG_IP_PNP=y
CONFIG_IRQ_DOMAIN_DEBUG=y
CONFIG_JFS_FS=y
CONFIG_KSZ884X_PCI=y
CONFIG_KVM_INTEL=y
CONFIG_KVM=y
CONFIG_LATENCYTOP=y
CONFIG_LEDS_CLASS=y
CONFIG_LEDS_GPIO=y
CONFIG_LEDS_TRIGGER_CPU=y
CONFIG_LEDS_TRIGGER_DEFAULT_ON=y
CONFIG_LEDS_TRIGGER_GPIO=y
CONFIG_LEDS_TRIGGER_HEARTBEAT=y
CONFIG_LEDS_TRIGGER_ONESHOT=y
CONFIG_LEDS_TRIGGER_TIMER=y
CONFIG_LEDS_TRIGGERS=y
"CONFIG_LOCALVERSION=""-ims"""
CONFIG_LOG_BUF_SHIFT=18
CONFIG_LPC_SCH=y
CONFIG_MCORE2=y
CONFIG_MEMCG=y
CONFIG_MFD_KEMPLD=y
CONFIG_MODULE_UNLOAD=y
CONFIG_MODULES=y
CONFIG_NAMESPACES=y
CONFIG_NET_CLS_IND=y
CONFIG_NET_CLS_U32=y
CONFIG_NET_DROP_MONITOR=y
CONFIG_NET_DSA=y
CONFIG_NET_PKTGEN=m
CONFIG_NET_SCH_HTB=y
CONFIG_NET_SCH_SFQ=y
CONFIG_NET_SCHED=y
CONFIG_NET=y
CONFIG_NETCONSOLE_DYNAMIC=y
CONFIG_NETCONSOLE=y
CONFIG_NETDEVICES=y
CONFIG_NETFILTER_XT_MATCH_STATISTIC=y
CONFIG_NETFILTER_XT_MATCH_TIME=y
CONFIG_NETFILTER_XT_TARGET_IDLETIMER=y
CONFIG_NETFILTER_XT_TARGET_LED=y
CONFIG_NETFILTER=y
CONFIG_NEW_LEDS=y
CONFIG_NFS_FS=y
CONFIG_NFSD_V3=y
CONFIG_NFSD=y
CONFIG_NLS_ASCII=y
CONFIG_NLS_CODEPAGE_437=y
CONFIG_NLS_ISO8859_1=y
CONFIG_NLS_UTF8=y
CONFIG_NR_CPUS=4
CONFIG_NVRAM=y
CONFIG_OPROFILE=y
CONFIG_PACKET=y
CONFIG_PARTITION_ADVANCED=y
CONFIG_PATA_JMICRON=y
CONFIG_PCI_MSI=y
CONFIG_PCIEPORTBUS=y
CONFIG_PHYSICAL_ALIGN=0x1000000
CONFIG_POSIX_MQUEUE=y
CONFIG_POWERCAP=y
CONFIG_PPP_ASYNC=y
CONFIG_PPP_SYNC_TTY=y
CONFIG_PPP=y
CONFIG_PRINTK_TIME=y
CONFIG_PROCESSOR_SELECT=y
CONFIG_PROFILING=y
CONFIG_RCU_CPU_STALL_TIMEOUT=60
CONFIG_ROOT_NFS=y
CONFIG_RT_GROUP_SCHED=y
CONFIG_RTC_CLASS=y
CONFIG_SATA_AHCI=m
CONFIG_SCHED_AUTOGROUP=y
CONFIG_SCSI_SCAN_ASYNC=y
CONFIG_SCU_PIC=y
CONFIG_SCU=y
CONFIG_SENSORS_ADT7475=y
CONFIG_SENSORS_CORETEMP=y
CONFIG_SENSORS_LIS3_I2C=y
CONFIG_SERIAL_8250_CONSOLE=y
CONFIG_SERIAL_8250=y
CONFIG_SMP=y
CONFIG_SND_SEQUENCER=y
CONFIG_SND_USB_AUDIO=y
CONFIG_SND=y
CONFIG_SOUND=y
CONFIG_SPARSEMEM_MANUAL=y
CONFIG_SPI_DEBUG=y
CONFIG_SPI_SC18IS602=y
CONFIG_SPI_SPIDEV=y
CONFIG_SPI=y
CONFIG_STRIP_ASM_SYMS=y
CONFIG_SYSFS_DEPRECATED_V2=y
CONFIG_SYSFS_DEPRECATED=y
CONFIG_SYSVIPC=y
CONFIG_TCP_CONG_ADVANCED=y
CONFIG_TCP_CONG_HSTCP=y
CONFIG_TCP_CONG_WESTWOOD=y
CONFIG_TRANSPARENT_HUGEPAGE=y
CONFIG_TUN=y
CONFIG_UNIX=y
CONFIG_USB_ANNOUNCE_NEW_DEVICES=y
CONFIG_USB_EHCI_HCD=y
CONFIG_USB_EHCI_ROOT_HUB_TT=y
CONFIG_USB_NET_PLUSB=y
CONFIG_USB_NET_QMI_WWAN=y
CONFIG_USB_SERIAL_CONSOLE=y
CONFIG_USB_SERIAL_FTDI_SIO=y
CONFIG_USB_SERIAL_GENERIC=y
CONFIG_USB_SERIAL_PL2303=y
CONFIG_USB_SERIAL_QUALCOMM=y
CONFIG_USB_SERIAL_SIERRAWIRELESS=y
CONFIG_USB_SERIAL=y
CONFIG_USB_SIERRA_NET=y
CONFIG_USB_STORAGE=y
CONFIG_USB_UHCI_HCD=y
CONFIG_USB_USBNET=y
CONFIG_USB=y
CONFIG_VFAT_FS=y
CONFIG_VGACON_SOFT_SCROLLBACK_SIZE=128
CONFIG_VGACON_SOFT_SCROLLBACK=y
CONFIG_VHOST_NET=y
CONFIG_VLAN_8021Q_GVRP=y
CONFIG_VLAN_8021Q=y
CONFIG_WATCHDOG_CORE=y
CONFIG_WATCHDOG=y
CONFIG_X86_ACPI_CPUFREQ=y
CONFIG_X86_CPUID=y
CONFIG_X86_MSR=y
```
